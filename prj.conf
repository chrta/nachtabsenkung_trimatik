## CMakeLists.txt
```
# SPDX-License-Identifier: Apache-2.0

cmake_minimum_required(VERSION 3.13.1)

find_package(Zephyr REQUIRED HINTS $ENV{ZEPHYR_BASE})
project(nachtabsenkung-trimatik)

FILE(GLOB app_sources src/*.c)
target_sources(app PRIVATE ${app_sources})
target_include_directories(app PRIVATE ${CMAKE_CURRENT_SOURCE_DIR})
```

## west.yml
```
# The west manifest.
#
# https://docs.zephyrproject.org/latest/guides/west/repo-tool.html
# based on T2 star topology
#
# It pulls in zephyr itself and the required libs for this project

manifest:
  remotes:
    - name: zephyrproject-rtos
      url-base: https://github.com/zephyrproject-rtos
  projects:
    - name: zephyr
      remote: zephyrproject-rtos
      revision: v2.3.0
      import:
        name-whitelist:
          - cmsis
          - hal_stm32

  self:
    path: application
```

## prj.conf
```kconfig
CONFIG_LOG=y
CONFIG_GPIO=y
CONFIG_ADC=y
CONFIG_COUNTER=y

# use external 32kHz XTAL as src
CONFIG_COUNTER_RTC_STM32_CLOCK_LSE=y
```

## src/main.c
```c
/*
 * Copyright (c) 2020 Christian Taedcke
 *
 * SPDX-License-Identifier: Apache-2.0
 */

#include <zephyr.h>

#include <sys/printk.h>

#include "controller.h"

void main(void)
{
	void* controller = ctrl_init();
	
	if (!controller) {
		printk("Failed to init ctrl\n");
		return;
	}

	while (1) {
		k_msleep(10000);
	}
}
```

## src/button.c
```c
/*
 * Copyright (c) 2020 Christian Taedcke
 *
 * SPDX-License-Identifier: Apache-2.0
 */

#include "buttons.h"

#include <zephyr.h>

#include <sys/printk.h>
#include <drivers/adc.h>

#include <string.h>

#if defined(CONFIG_BOARD_NUCLEO_F429ZI)
#define ADC_DEVICE_NAME         DT_LABEL(DT_INST(0, st_stm32_adc))
#define ADC_RESOLUTION		12
#define ADC_GAIN		ADC_GAIN_1
#define ADC_REFERENCE		ADC_REF_INTERNAL
#define ADC_ACQUISITION_TIME	ADC_ACQ_TIME_DEFAULT
#define ADC_CHANNEL_ID	3
#elif defined(CONFIG_BOARD_NUCLEO_F446RE)
#define ADC_DEVICE_NAME         DT_LABEL(DT_INST(0, st_stm32_adc))
#define ADC_RESOLUTION		12
#define ADC_GAIN		ADC_GAIN_1
#define ADC_REFERENCE		ADC_REF_INTERNAL
#define ADC_ACQUISITION_TIME	ADC_ACQ_TIME_DEFAULT
#define ADC_CHANNEL_ID	0
#else
#error "Unsupported board"
#endif

static const struct adc_channel_cfg adc_channel_cfg = {
	.gain             = ADC_GAIN,
	.reference        = ADC_REFERENCE,
	.acquisition_time = ADC_ACQUISITION_TIME,
	.channel_id       = ADC_CHANNEL_ID,
};

#define BUFFER_SIZE  6
static int16_t m_sample_buffer[BUFFER_SIZE];

enum adc_action adc_handler(struct device *dev,
			    const struct adc_sequence *sequence,
			    uint16_t sampling_index)
{
	int16_t v = m_sample_buffer[0];
	printk("Sample %d\n", v);
	return ADC_ACTION_REPEAT;
}

struct adc_sequence_options options = {
	.interval_us = 1000000, /* once a second */
	.callback = adc_handler
};

static const struct adc_sequence sequence = {
	.options     = NULL /*&options*/,
	.channels    = BIT(ADC_CHANNEL_ID),
	.buffer      = m_sample_buffer,
	.buffer_size = sizeof(m_sample_buffer),
	.resolution  = ADC_RESOLUTION,
};


#define BUTTON_STACK_SIZE 500
#define BUTTON_THREAD_PRIORITY 5

#define ADC_DELTA 10
#define ADC_BUTTON_CHANGE 100

static int diff(int v1, int v2)
{
	if (v1 > v2) {
		return v1 - v2;
	}

	return v2 - v1;
}

static bool button_decode(int16_t v, enum button_type* type)
{
	if (v > 4080) {
		*type = BUTTON_SELECT;
		return true;
	}
	
	if (v > 2900) {
		*type = BUTTON_NONE;
		return true;
	}

	if (v > 2400) {
		*type = BUTTON_LEFT;
		return true;
	}

	if (v > 1700) {
		*type = BUTTON_DOWN;
		return true;
	}

	if (v > 750) {
		*type = BUTTON_UP;
		return true;
	}


	if (v < 100) {
		*type = BUTTON_RIGHT;
		return true;
	}

	return false;
}

static void button_func(void *adc_dev, void *cb_func, void *u3)
{
	int ret;
	int prev_v = 0;
	int prev_stable = 0;
	bool res;
	enum button_type type;
	enum button_type prev_type = BUTTON_NONE;
	struct device *dev = adc_dev;
	button_cb *cb = cb_func;
	
	for(;;) {
		
		ret = adc_read(dev, &sequence);
		
		if (ret) {
			printk("Failed to read from adc\n");
			return;
		}
		
		int16_t v = m_sample_buffer[0];
		if (diff(v, prev_v) < ADC_DELTA) {
			/* measurement is ok, use it */
			if (diff(v, prev_stable) > ADC_BUTTON_CHANGE) {
				printk("ADC change from %d to %d\n", prev_stable, v);
				res = button_decode(v, &type);
				if (prev_type != type) {
					if (type == BUTTON_NONE) {
						cb(dev, prev_type, BUTTON_RELEASED);
					} else {
						cb(dev, type, BUTTON_PRESSED);						
					}
					prev_type = type;
				}
				prev_stable = v;
			}
		}
		prev_v = v;
		k_msleep(50);
	}
}

K_THREAD_STACK_DEFINE(button_stack_area, BUTTON_STACK_SIZE);
static struct k_thread button_thread_data;

void *buttons_init(button_cb cb)
{
	int ret;
	struct device *adc_dev = device_get_binding(ADC_DEVICE_NAME);

	if (!adc_dev) {
		printk("Failed to get adc dev\n");
		return NULL;
	}

	ret = adc_channel_setup(adc_dev, &adc_channel_cfg);

	if (ret) {
		printk("Failed to init adc\n");
		return NULL;
	}

	(void)memset(m_sample_buffer, 0, sizeof(m_sample_buffer));

	k_thread_create(&button_thread_data, button_stack_area,
			K_THREAD_STACK_SIZEOF(button_stack_area),
			button_func,
			adc_dev, cb, NULL,
			BUTTON_THREAD_PRIORITY, 0, K_NO_WAIT);

	return adc_dev;
}

bool buttons_poll(void *btn_dev, enum button_type *type)
{
	struct device* dev = btn_dev; 
	int ret;
	
	ret = adc_read(dev, &sequence);

	if (ret) {
		printk("Failed to read from adc\n");
		return false;
	}

	int16_t v = m_sample_buffer[0];

	printk("Sample value %d\n", v);
	if (button_decode(v, type)) {
		return true;
	}

	printk("Cannot detect button for %d\n", v);
	return false;
}
```

## src/buttons.h
```c
/*
 * Copyright (c) 2020 Christian Taedcke
 *
 * SPDX-License-Identifier: Apache-2.0
 */

#ifndef APP_BUTTONS_H
#define APP_BUTTONS_H

#include <zephyr.h>

enum button_type {
	BUTTON_NONE,
	BUTTON_SELECT,
	BUTTON_LEFT,
	BUTTON_RIGHT,
	BUTTON_UP,
	BUTTON_DOWN,
};

#define BUTTON_RELEASED false
#define BUTTON_PRESSED true

typedef void (button_cb)(void* dev, enum button_type, bool);

void *buttons_init(button_cb cb);

bool buttons_poll(void *dev, enum button_type *type);

#endif /*APP_BUTTONS_H*/
```

## src/clock.c
```c
/*
 * Copyright (c) 2020 Christian Taedcke
 *
 * SPDX-License-Identifier: Apache-2.0
 */

#include "clock.h"

#include <drivers/counter.h>
#include <soc.h>

#include <string.h>

#if defined(CONFIG_BOARD_NUCLEO_F429ZI) || defined(CONFIG_BOARD_NUCLEO_F446RE)
#define RTC_DEVICE_NAME         DT_LABEL(DT_INST(0, st_stm32_rtc))
#else
#error "Unsupported board"
#endif

#ifdef CONFIG_COUNTER_RTC_STM32
struct tm* clock_rtc_read(void* dev)
{
	static struct tm now = { 0 };
	uint32_t rtc_date, rtc_time;

	ARG_UNUSED(dev);
	
	/* Read time and date registers */
	rtc_time = LL_RTC_TIME_Get(RTC);
	rtc_date = LL_RTC_DATE_Get(RTC);

	/* Convert calendar datetime to UNIX timestamp */
	/* RTC start time: 1st, Jan, 2000 */
	/* time_t start:   1st, Jan, 1900 */
	now.tm_year = 100 +
			__LL_RTC_CONVERT_BCD2BIN(__LL_RTC_GET_YEAR(rtc_date));
	/* tm_mon allowed values are 0-11 */
	now.tm_mon = __LL_RTC_CONVERT_BCD2BIN(__LL_RTC_GET_MONTH(rtc_date)) - 1;
	now.tm_mday = __LL_RTC_CONVERT_BCD2BIN(__LL_RTC_GET_DAY(rtc_date));
	now.tm_wday = __LL_RTC_CONVERT_BCD2BIN(__LL_RTC_GET_WEEKDAY(rtc_date));
	if (now.tm_wday >= LL_RTC_WEEKDAY_SUNDAY)
	{
		now.tm_wday = 0;
	}

	now.tm_hour = __LL_RTC_CONVERT_BCD2BIN(__LL_RTC_GET_HOUR(rtc_time));
	now.tm_min = __LL_RTC_CONVERT_BCD2BIN(__LL_RTC_GET_MINUTE(rtc_time));
	now.tm_sec = __LL_RTC_CONVERT_BCD2BIN(__LL_RTC_GET_SECOND(rtc_time));

	return &now;
}

void clock_rtc_set(void *dev, const struct tm *now)
{
	ARG_UNUSED(now);

	LL_RTC_DisableWriteProtection(RTC);
	//BCD Format!!! 23 uhr = 0x23
	LL_RTC_EnableInitMode(RTC);

	k_msleep(100);
	LL_RTC_TIME_Config(RTC, LL_RTC_TIME_FORMAT_AM_OR_24,
			   __LL_RTC_CONVERT_BIN2BCD(now->tm_hour),
			   __LL_RTC_CONVERT_BIN2BCD(now->tm_min),
			   __LL_RTC_CONVERT_BIN2BCD(now->tm_sec));
	/* now->tm_year is since 1900 */
	LL_RTC_DATE_Config(RTC,
			   now->tm_wday == 0 ? LL_RTC_WEEKDAY_SUNDAY : now->tm_wday,
			   __LL_RTC_CONVERT_BIN2BCD(now->tm_mday),
			   __LL_RTC_CONVERT_BIN2BCD(now->tm_mon + 1),
			   __LL_RTC_CONVERT_BIN2BCD(now->tm_year - 100));
	LL_RTC_DisableInitMode(RTC);
	LL_RTC_EnableWriteProtection(RTC);
}

bool clock_rtc_reg_read(void* buffer, size_t len)
{
	if (len > 18 * 4) {
		printk("Trying to read too much data");
		return false;
	}
	uint32_t data;
	for (size_t i = 0; i < len; i += 4) {
		data = LL_RTC_BAK_GetRegister(RTC, LL_RTC_BKP_DR0 + (i / 4));
		memcpy((uint8_t*)buffer + i, &data, (len - i) >= 4 ? 4 : len - i);
	}
	return true;

}

bool clock_rtc_reg_write(const void* buffer, size_t len)
{
	if (len > 18 * 4) {
		printk("Trying to store too much data");
		return false;
	}
	uint32_t data = 0;
	for (size_t i = 0; i < len; i +=4) {
		data = 0;
		memcpy(&data, (const uint8_t*) buffer + i, (len - i) >= 4 ? 4 : len - i);
		LL_RTC_BAK_SetRegister(RTC, LL_RTC_BKP_DR0 + (i / 4), data);
	}
	return true;
}

#endif

void* clock_init(void)
{
	struct device *rtc_dev = device_get_binding(RTC_DEVICE_NAME);

	if (!rtc_dev) {
		printk("Failed to get adc dev\n");
		return NULL;
	}

	return rtc_dev;
}
```

## src/clock.h
```c
/*
 * Copyright (c) 2020 Christian Taedcke
 *
 * SPDX-License-Identifier: Apache-2.0
 */

#ifndef APP_CLOCK_H
#define APP_CLOCK_H

#include <time.h>
#include <stdbool.h>

void* clock_init(void);

struct tm* clock_rtc_read(void* dev);

void clock_rtc_set(void *dev, const struct tm *now);

bool clock_rtc_reg_read(void* buffer, size_t len);

bool clock_rtc_reg_write(const void* buffer, size_t len);

#endif /* APP_CLOCK_H */
```

## src/controller.c
```c
/*
 * Copyright (c) 2020 Christian Taedcke
 *
 * SPDX-License-Identifier: Apache-2.0
 */

#include <logging/log.h>
LOG_MODULE_REGISTER(ctr, CONFIG_LOG_DEFAULT_LEVEL);

#include "controller.h"

#include "lcd.h"
#include "buttons.h"
#include "clock.h"
#include "output.h"

#include <string.h>
#include <stdio.h>


#define CTRL_STACK_SIZE 2000
#define CTRL_THREAD_PRIORITY 6

static const char* DAY_STR[] =
{"So", "Mo", "Di", "Mi", "Do", "Fr", "Sa"};

static const char* MODE_STR[] =
{"Aus", "Tag", "Nacht"};

enum op_mode {
	OP_MODE_OFF = 0,
	OP_MODE_DAY,
	OP_MODE_NIGHT
};

struct ctrl_time {
	uint8_t hour;
	uint8_t minute;
};

struct ctrl_settings {
	struct ctrl_time day_begin;
	struct ctrl_time day_end;
};

#define PERSISTENT_SETTINGS_MAGIC (0xAA551234)

struct persistent_ctrl_settings {
	uint32_t magic_no;
	struct ctrl_settings settings;
} __attribute__((packed));

struct cursor {
	uint8_t row;
	uint8_t col;
	bool blinking;
};

enum input_mode {
	INPUT_MODE_VIEW = 0,
	INPUT_MODE_EDIT_CLOCK_HOUR,
	INPUT_MODE_EDIT_CLOCK_MINUTE,
	INPUT_MODE_EDIT_DAY,
	INPUT_MODE_EDIT_SCHEDULE_BEGIN_HOUR,
	INPUT_MODE_EDIT_SCHEDULE_BEGIN_MINUTE,
	INPUT_MODE_EDIT_SCHEDULE_END_HOUR,
	INPUT_MODE_EDIT_SCHEDULE_END_MINUTE,
	INPUT_MODE_LAST //must be always last entry
};

struct ctx {
	void* lcd;
	void* buttons;
	void* output;
	void* clock;

	struct cursor cursor;

	enum op_mode mode;
	struct ctrl_settings settings;

	enum input_mode input_mode;
};

static struct ctx ctrl_ctx;

struct msgq_item_t {
	uint8_t button_index;
	uint8_t button_pressed;
	uint32_t duration_msec;
};

K_MSGQ_DEFINE(ctrl_msgq, sizeof(struct msgq_item_t), 30, 4);

K_THREAD_STACK_DEFINE(ctrl_stack_area, CTRL_STACK_SIZE);
static struct k_thread ctrl_thread_data;

static void user_input_expiry_function(struct k_timer *timer_id);

K_TIMER_DEFINE(user_input_timer, user_input_expiry_function, NULL);

#if 0
void show_date_time(void *lcd, struct tm *now)
{
	static char time_buffer[16];
	static char date_buffer[16];

	sprintf(date_buffer, "%02d.%02d.%02d", now->tm_mday,
		now->tm_mon + 1, now->tm_year - 100);
	sprintf(time_buffer, "%02d:%02d:%02d", now->tm_hour, now->tm_min, now->tm_sec);
	//lcd_clear(lcd);
	/*k_msleep(MSEC_PER_SEC * 3U);*/
	lcd_set_cursor(lcd, 0, 0);
	
	lcd_string(lcd, date_buffer);
	lcd_set_cursor(lcd, 0, 1);
	lcd_string(lcd, time_buffer);
}
#endif

void show_main_screen(struct ctx *ctx, struct tm *now)
{
	static char line1[17];
	static char line2[17];

	snprintf(line1, sizeof(line1), "%02d:%02d  %s  %s",
		 now->tm_hour, now->tm_min, DAY_STR[now->tm_wday], MODE_STR[ctx->mode]);

	line1[sizeof(line1) - 1] = '\0';
	snprintf(line2, sizeof(line2), " %02d:%02d - %02d:%02d",
		ctx->settings.day_begin.hour, ctx->settings.day_begin.minute,
		ctx->settings.day_end.hour, ctx->settings.day_end.minute
		);
	line2[sizeof(line2) - 1] = '\0';
	
	//lcd_clear(lcd);
	/*k_msleep(MSEC_PER_SEC * 3U);*/
	lcd_set_cursor(ctx->lcd, 0, 0);
	
	lcd_string(ctx->lcd, line1);
	lcd_set_cursor(ctx->lcd, 0, 1);
	lcd_string(ctx->lcd, line2);
}

void ctrl_button_handler(void* dev, enum button_type type, bool pressed)
{
	static struct msgq_item_t tx_data;
	static int64_t last_button_event = 0;
	if (pressed) {
		last_button_event = k_uptime_get();
	}
	tx_data.button_index = type;
	tx_data.button_pressed = pressed;
	tx_data.duration_msec = (uint32_t) k_uptime_delta(&last_button_event);
	last_button_event = k_uptime_get();
	LOG_INF("Button %d %s (%d ms)\n", type, pressed ? "pressed" : "released", tx_data.duration_msec);
	k_msgq_put(&ctrl_msgq, &tx_data, K_NO_WAIT);
}

static void ctrl_reset_screen(void) {
	void *lcd = ctrl_ctx.lcd;
	lcd_backlight(lcd, false);
	ctrl_ctx.cursor.col = 0;
	ctrl_ctx.cursor.row = 0;
	LOG_DBG("");
}

static void user_input_expiry_function(struct k_timer *timer_id)
{
	LOG_INF("Input timer expired");
	ctrl_reset_screen();
	ctrl_ctx.input_mode = INPUT_MODE_VIEW;
}

static enum op_mode calc_new_mode(struct ctrl_settings* settings, struct tm* now)
{
	LOG_DBG("");
	if (now->tm_hour < settings->day_begin.hour) {
		return OP_MODE_NIGHT;
	}
	if (now->tm_hour > settings->day_end.hour) {
		return OP_MODE_NIGHT;
	}
	if ((now->tm_hour == settings->day_begin.hour) &&
	    (now->tm_min < settings->day_begin.minute)) {
		return OP_MODE_NIGHT;
	}
	if ((now->tm_hour == settings->day_end.hour) &&
	    (now->tm_min > settings->day_end.minute)) {
		return OP_MODE_NIGHT;
	}

	return OP_MODE_DAY;
}

static void ctrl_set_cursor_pos(enum input_mode input_mode)
{
	void *lcd = ctrl_ctx.lcd;
	
	switch(input_mode) {
	case INPUT_MODE_VIEW:
	case INPUT_MODE_EDIT_CLOCK_HOUR:
		ctrl_ctx.cursor.row = 0;
		ctrl_ctx.cursor.col = 1;
		break;
	case INPUT_MODE_EDIT_CLOCK_MINUTE:
		ctrl_ctx.cursor.row = 0;
		ctrl_ctx.cursor.col = 4;
		break;	
	case INPUT_MODE_EDIT_DAY:
		ctrl_ctx.cursor.row = 0;
		ctrl_ctx.cursor.col = 7;
		break;
	case INPUT_MODE_EDIT_SCHEDULE_BEGIN_HOUR:
		ctrl_ctx.cursor.row = 1;
		ctrl_ctx.cursor.col = 2;
		break;
	case INPUT_MODE_EDIT_SCHEDULE_BEGIN_MINUTE:
		ctrl_ctx.cursor.row = 1;
		ctrl_ctx.cursor.col = 5;
		break;
	case INPUT_MODE_EDIT_SCHEDULE_END_HOUR:
		ctrl_ctx.cursor.row = 1;
		ctrl_ctx.cursor.col = 10;
		break;
	case INPUT_MODE_EDIT_SCHEDULE_END_MINUTE:
		ctrl_ctx.cursor.row = 1;
		ctrl_ctx.cursor.col = 13;
		break;
	case INPUT_MODE_LAST:
	default:
		ctrl_ctx.cursor.row = 0;
		ctrl_ctx.cursor.col = 0;
	}
	lcd_set_cursor(lcd, ctrl_ctx.cursor.col, ctrl_ctx.cursor.row);
}

static void ctrl_change_cap_hour(uint8_t* current, int8_t delta)
{
	int16_t new_value = *current + delta;

	if (new_value < 0) {
		new_value = 0;
	} else if (new_value > 23) {
		new_value = 23;
	}
	*current = new_value;
}

static void ctrl_change_cap_minute(uint8_t* current, int8_t delta)
{
	int16_t new_value = *current + delta;

	if (new_value < 0) {
		new_value = 0;
	} else if (new_value > 59) {
		new_value = 59;
	}
	*current = new_value;
}

static void ctrl_change_current_item(int8_t delta)
{
	struct tm now_set;
	struct tm* now;
	int new_val;
	
	switch(ctrl_ctx.input_mode) {
	case INPUT_MODE_VIEW:
		LOG_ERR("view mode, should never get here!!");
		return;
	case INPUT_MODE_EDIT_CLOCK_HOUR:
		LOG_INF("Change clock hour");
		now = clock_rtc_read(ctrl_ctx.clock);
		now_set = *now;
		new_val = now_set.tm_hour + delta;
		if (new_val < 0) {
			new_val = 0;
		} else if (new_val > 23) {
			new_val = 23;
		}
		now_set.tm_hour = new_val;
		clock_rtc_set(ctrl_ctx.clock, &now_set);
		break;
	case INPUT_MODE_EDIT_CLOCK_MINUTE:
		LOG_INF("Change clock minute");
		now = clock_rtc_read(ctrl_ctx.clock);
		now_set = *now;
		new_val = now_set.tm_min + delta;
		if (new_val < 0) {
			new_val = 0;
		} else if (new_val > 59) {
			new_val = 59;
		}
		now_set.tm_min = new_val;
		clock_rtc_set(ctrl_ctx.clock, &now_set);
		break;	
	case INPUT_MODE_EDIT_DAY:
		LOG_INF("Change clock day");
		now = clock_rtc_read(ctrl_ctx.clock);
		now_set = *now;
		new_val = now_set.tm_wday + delta;
		if (new_val < 0) {
			new_val = 6;
		} else if (new_val > 6) {
			new_val = 0;
		}
		now_set.tm_wday = new_val;
		clock_rtc_set(ctrl_ctx.clock, &now_set);
		break;
	case INPUT_MODE_EDIT_SCHEDULE_BEGIN_HOUR:
		LOG_INF("Change sched begin hour by %d", delta);
		ctrl_change_cap_hour(&ctrl_ctx.settings.day_begin.hour, delta);
		break;
	case INPUT_MODE_EDIT_SCHEDULE_BEGIN_MINUTE:
		LOG_INF("Change sched begin minute by %d", delta);
		ctrl_change_cap_minute(&ctrl_ctx.settings.day_begin.minute, delta);
		break;
	case INPUT_MODE_EDIT_SCHEDULE_END_HOUR:
		LOG_INF("Change sched end hour by %d", delta);
		ctrl_change_cap_hour(&ctrl_ctx.settings.day_end.hour, delta);
		break;
	case INPUT_MODE_EDIT_SCHEDULE_END_MINUTE:
		LOG_INF("Change sched end minute by %d", delta);
		ctrl_change_cap_minute(&ctrl_ctx.settings.day_end.minute, delta);
		break;
	case INPUT_MODE_LAST:
	default:
		break;
	}

	if ((ctrl_ctx.input_mode == INPUT_MODE_EDIT_SCHEDULE_BEGIN_HOUR) ||
	    (ctrl_ctx.input_mode == INPUT_MODE_EDIT_SCHEDULE_BEGIN_MINUTE) ||
	    (ctrl_ctx.input_mode == INPUT_MODE_EDIT_SCHEDULE_END_HOUR) ||
	    (ctrl_ctx.input_mode == INPUT_MODE_EDIT_SCHEDULE_END_MINUTE))
	{
		struct persistent_ctrl_settings settings = {
			.magic_no = PERSISTENT_SETTINGS_MAGIC,
			.settings = ctrl_ctx.settings
		};
		if (!clock_rtc_reg_write(&settings, sizeof(settings))) {
			LOG_ERR("Failed to persist settings in rtc regs");
		}
	}
}

static void ctrl_set_output_pins(void)
{
	LOG_INF("Setting output pins for mode %d", ctrl_ctx.mode);
	
	switch(ctrl_ctx.mode) {
	case OP_MODE_DAY:
		output_set(ctrl_ctx.output, OUTPUT_DAY);
		break;
	case OP_MODE_NIGHT:
		output_set(ctrl_ctx.output, OUTPUT_NIGHT);
		break;
	case OP_MODE_OFF:
	default:
		output_set(ctrl_ctx.output, OUTPUT_OFF);
		break;
	}
}

static void ctrl_func(void *ctx, void *u2, void *u3)
{
	void *lcd = ctrl_ctx.lcd;
	void *clock = ctrl_ctx.clock;
	//void *buttons = ctrl_ctx.buttons;
	struct msgq_item_t event;
	int res;
	struct tm *now;

	struct tm now_set = {
		.tm_sec = 30,
		.tm_min = 23,
		.tm_hour = 19,
		.tm_mday = 4,
		.tm_wday = 6,
		.tm_mon = 6,
		.tm_year = 120
	};


	//enable backlight
	lcd_backlight(lcd, true);

	/* Clear display */
	lcd_clear(lcd);
	/*k_msleep(MSEC_PER_SEC * 3U);*/
	lcd_set_cursor(lcd, 0, 0);
	lcd_string(lcd, "Heizungs-Ctrl");
	lcd_set_cursor(lcd, 0, 1);
	lcd_string(lcd, "V 2020-07-04");
	
	now = clock_rtc_read(clock);
	if (now->tm_year < 120) {
		//if rtc returns date before 2020, set clock to some hardcoded default
		clock_rtc_set(clock, &now_set);
	}

	k_msleep(MSEC_PER_SEC * 3U);
	ctrl_ctx.cursor.row = 0;
	ctrl_ctx.cursor.col = 0;

	k_timer_start(&user_input_timer, K_SECONDS(30), K_NO_WAIT);

	/* to unblock to init lcd and state */
	static struct msgq_item_t tx_data = {
		.button_index = BUTTON_NONE,
		.button_pressed = false,
	};
	k_msgq_put(&ctrl_msgq, &tx_data, K_NO_WAIT);
	
	while (1) {
		res = k_msgq_get(&ctrl_msgq, &event, K_MSEC(15000));

		struct tm* now = clock_rtc_read(clock);
		enum op_mode new_mode = calc_new_mode(&ctrl_ctx.settings, now);
		if (new_mode != ctrl_ctx.mode) {
			LOG_INF("Switching modes (%s -> %s)", MODE_STR[ctrl_ctx.mode], MODE_STR[new_mode]);
			ctrl_ctx.mode = new_mode;
			ctrl_set_output_pins();
		}
		
		if (res) {
			/* Clear display */
			lcd_clear(lcd);
			show_main_screen(&ctrl_ctx, now);
			continue;
		}
		
		if (!event.button_pressed) {
			LOG_INF("Restarting input timer");
			lcd_backlight(lcd, true);
			k_timer_start(&user_input_timer, K_SECONDS(30), K_NO_WAIT);
			// handle input
			switch (event.button_index) {
			case BUTTON_SELECT:
				/* so the select button was released */
				if ((event.duration_msec >= 3000) && (ctrl_ctx.input_mode == INPUT_MODE_VIEW)) {
					LOG_INF("Change into edit mode");
					ctrl_ctx.input_mode = INPUT_MODE_EDIT_CLOCK_HOUR;
				} else if (ctrl_ctx.input_mode != INPUT_MODE_VIEW) {
					LOG_INF("Change into view mode");
					ctrl_ctx.input_mode = INPUT_MODE_VIEW;
				}
				break;
			case BUTTON_RIGHT:
				if (ctrl_ctx.input_mode > INPUT_MODE_VIEW) {
					ctrl_ctx.input_mode++;
					if (ctrl_ctx.input_mode >= INPUT_MODE_LAST) {
						ctrl_ctx.input_mode = INPUT_MODE_EDIT_CLOCK_HOUR;
					}
				}
				break;
			case BUTTON_LEFT:
				if (ctrl_ctx.input_mode > INPUT_MODE_VIEW) {
					ctrl_ctx.input_mode--;
					if (ctrl_ctx.input_mode <= INPUT_MODE_VIEW) {
						ctrl_ctx.input_mode = INPUT_MODE_LAST - 1;
					}
				}
				break;
			case BUTTON_UP:
				if (ctrl_ctx.input_mode > INPUT_MODE_VIEW) {
					//change current setting
					ctrl_change_current_item(1);
				}
				break;
			case BUTTON_DOWN:
				if (ctrl_ctx.input_mode > INPUT_MODE_VIEW) {
					//change current setting
					ctrl_change_current_item(-1);
				}
				break;
				
			default:
				lcd_blink_off(lcd);				
			}
		}
		LOG_INF("1 - %d", ctrl_ctx.input_mode);
		if (!event.button_pressed) {
			/* Clear display */
			lcd_clear(lcd);
			now = clock_rtc_read(clock);
			show_main_screen(&ctrl_ctx, now);
			LOG_INF("3 - %d", ctrl_ctx.input_mode);
					
		}
		LOG_INF("2 - %d", ctrl_ctx.input_mode);

		if (ctrl_ctx.input_mode > INPUT_MODE_VIEW) {
			ctrl_set_cursor_pos(ctrl_ctx.input_mode);
			lcd_blink_on(lcd);
		} else {
			lcd_blink_off(lcd);
		}
		LOG_INF("4 - %d", ctrl_ctx.input_mode);
				
	}
}

void* ctrl_init(void)
{
	struct persistent_ctrl_settings read_settings;
	ctrl_ctx.input_mode = INPUT_MODE_VIEW;
	ctrl_ctx.settings.day_begin.hour = 6;
	ctrl_ctx.settings.day_begin.minute = 0;
	ctrl_ctx.settings.day_end.hour = 22;
	ctrl_ctx.settings.day_end.minute = 0;
	ctrl_ctx.mode = OP_MODE_OFF;
	ctrl_ctx.lcd = lcd_init();
	
	if (!ctrl_ctx.lcd) {
		LOG_ERR("Failed to init lcd\n");
		return NULL;
	}

	ctrl_ctx.buttons = buttons_init(ctrl_button_handler);

	if (!ctrl_ctx.buttons) {
		LOG_ERR("Failed to init button driver\n");
		return NULL;
	}

	ctrl_ctx.output = output_init();

	if (!ctrl_ctx.output) {
		LOG_ERR("Failed to init output driver\n");
		return NULL;
	}

	ctrl_ctx.clock = clock_init();

	if (!ctrl_ctx.clock) {
		LOG_ERR("Failed to init clock driver\n");
		return NULL;
	}

	if (!clock_rtc_reg_read(&read_settings, sizeof(read_settings))) {
		LOG_ERR("Failed read settings from rtc regs\n");
	} else {
		if (read_settings.magic_no != PERSISTENT_SETTINGS_MAGIC) {
			LOG_WRN("Settings from RTC wo magic, discarding");
		} else {
			ctrl_ctx.settings = read_settings.settings;
		}
	}

	k_thread_create(&ctrl_thread_data, ctrl_stack_area,
			K_THREAD_STACK_SIZEOF(ctrl_stack_area),
			ctrl_func,
			&ctrl_ctx, NULL, NULL,
			CTRL_THREAD_PRIORITY, 0, K_NO_WAIT);

	return &ctrl_ctx;
}
```

## src/controller.h
```c
/*
 * Copyright (c) 2020 Christian Taedcke
 *
 * SPDX-License-Identifier: Apache-2.0
 */

#ifndef APP_CONTROLLER_H
#define APP_CONTROLLER_H

#include <zephyr.h>

void* ctrl_init(void);

#endif /* APP_CONTROLLER_H */
```

## src/lcd.c
```c
/*
 * Copyright (c) 2020 Christian Taedcke
 *
 * SPDX-License-Identifier: Apache-2.0
 */

#include "lcd.h"

#include <sys/printk.h>
#include <drivers/gpio.h>
#include <string.h>

#if defined(CONFIG_BOARD_NUCLEO_F429ZI)
/*	https://wiki.dfrobot.com/Arduino_LCD_KeyPad_Shield__SKU__DFR0009_ */
/* Define GPIO OUT to LCD */
#define GPIO_PIN_D4		14	/* DB4 PF14 */
#define GPIO_PORT_D4	        "GPIOF"
#define GPIO_PIN_D5		11	/* DB5 PE11 */
#define GPIO_PORT_D5	        "GPIOE"
#define GPIO_PIN_D6		9	/* DB6 PE9 */
#define GPIO_PORT_D6	        "GPIOE"
#define GPIO_PIN_D7		13	/* DB7 PF13 */
#define GPIO_PORT_D7	        "GPIOF"
#define GPIO_PIN_RS		12	/* D8 RS PF12 */
#define GPIO_PORT_RS	        "GPIOF"
#define GPIO_PIN_E		15	/* D9 Enable PD15 */
#define GPIO_PORT_E	        "GPIOD"
#define GPIO_PIN_BL       14               /* D10 backlight control PD14 */
#define GPIO_PORT_BL	        "GPIOD"
#elif defined(CONFIG_BOARD_NUCLEO_F446RE)
#define GPIO_PIN_D4		5	/* DB4 PB5 */
#define GPIO_PORT_D4	        "GPIOB"
#define GPIO_PIN_D5		4	/* DB5 PB4 */
#define GPIO_PORT_D5	        "GPIOB"
#define GPIO_PIN_D6		10	/* DB6 PB10 */
#define GPIO_PORT_D6	        "GPIOB"
#define GPIO_PIN_D7		8	/* DB7 PA8 */
#define GPIO_PORT_D7	        "GPIOA"
#define GPIO_PIN_RS		9	/* D8 RS PA9 */
#define GPIO_PORT_RS	        "GPIOA"
#define GPIO_PIN_E		7	/* D9 Enable PC7 */
#define GPIO_PORT_E	        "GPIOC"
#define GPIO_PIN_BL       6               /* D10 backlight control PB6 */
#define GPIO_PORT_BL	        "GPIOB"
#else
#error "unsupported board"
#endif

struct gpio_info {
	const char* port;
	const uint8_t index;
	struct device *dev;
};

enum gpio_index {
	GPIO_IDX_D4 = 0,
	GPIO_IDX_D5,
	GPIO_IDX_D6,
	GPIO_IDX_D7,
	GPIO_IDX_RS,
	GPIO_IDX_E,
	GPIO_IDX_BL,
};

static struct gpio_info global_gpios[] = {
	{GPIO_PORT_D4, GPIO_PIN_D4, NULL},
	{GPIO_PORT_D5, GPIO_PIN_D5, NULL},
	{GPIO_PORT_D6, GPIO_PIN_D6, NULL},
	{GPIO_PORT_D7, GPIO_PIN_D7, NULL},
	{GPIO_PORT_RS, GPIO_PIN_RS, NULL},
	{GPIO_PORT_E, GPIO_PIN_E, NULL},
	{GPIO_PORT_BL, GPIO_PIN_BL, NULL},
};

/* Commands */
#define LCD_CLEAR_DISPLAY		0x01
#define LCD_RETURN_HOME			0x02
#define LCD_ENTRY_MODE_SET		0x04
#define LCD_DISPLAY_CONTROL		0x08
#define LCD_CURSOR_SHIFT		0x10
#define LCD_FUNCTION_SET		0x20
#define LCD_SET_CGRAM_ADDR		0x40
#define LCD_SET_DDRAM_ADDR		0x80

/* Display entry mode */
#define LCD_ENTRY_RIGHT			0x00
#define LCD_ENTRY_LEFT			0x02
#define LCD_ENTRY_SHIFT_INCREMENT	0x01
#define LCD_ENTRY_SHIFT_DECREMENT	0x00

/* Display on/off control */
#define LCD_DISPLAY_ON			0x04
#define LCD_DISPLAY_OFF			0x00
#define LCD_CURSOR_ON			0x02
#define LCD_CURSOR_OFF			0x00
#define LCD_BLINK_ON			0x01
#define LCD_BLINK_OFF			0x00

/* Display/cursor shift */
#define LCD_DISPLAY_MOVE		0x08
#define LCD_CURSOR_MOVE			0x00
#define LCD_MOVE_RIGHT			0x04
#define LCD_MOVE_LEFT			0x00

/* Function set */
#define LCD_8BIT_MODE			0x10
#define LCD_4BIT_MODE			0x00
#define LCD_2_LINE			0x08
#define LCD_1_LINE			0x00
#define LCD_5x10_DOTS			0x04
#define LCD_5x8_DOTS			0x00

/* Define some device constants */
#define LCD_WIDTH			20	/* Max char per line */
#define HIGH				1
#define LOW				0
/* in millisecond */
#define	ENABLE_DELAY			1/*10*/


struct pi_lcd_data {
	uint8_t	disp_func;	/* Display Function */
	uint8_t	disp_cntl;	/* Display Control */
	uint8_t disp_mode;	/* Display Mode */
	uint8_t	cfg_rows;
	uint8_t	row_offsets[4];
};

/* Default Configuration - User can update */
struct pi_lcd_data lcd_data = {
	.disp_func = LCD_4BIT_MODE | LCD_2_LINE | LCD_5x8_DOTS,
	.disp_cntl = 0,
	.disp_mode = 0,
	.cfg_rows = 0,
	.row_offsets = {0x00, 0x00, 0x00, 0x00}
};

void _set_row_offsets(int8_t row0, int8_t row1, int8_t row2, int8_t row3)
{
	lcd_data.row_offsets[0] = row0;
	lcd_data.row_offsets[1] = row1;
	lcd_data.row_offsets[2] = row2;
	lcd_data.row_offsets[3] = row3;
}

static inline void lcd_gpio_write(struct gpio_info* gpios, enum gpio_index idx, int value)
{
	struct gpio_info *gi = &gpios[idx];
	if (gpio_pin_set_raw(gi->dev, gi->index, value)) {
		printk("Failed to set idx %d to %d\n", idx, value);
	}
}

void _pi_lcd_toggle_enable(struct gpio_info* gpios)
{
	lcd_gpio_write(gpios, GPIO_IDX_E, LOW);
	k_msleep(ENABLE_DELAY);
	lcd_gpio_write(gpios, GPIO_IDX_E, HIGH);
	k_msleep(ENABLE_DELAY);
	lcd_gpio_write(gpios, GPIO_IDX_E, LOW);
	k_msleep(ENABLE_DELAY);
}


void _pi_lcd_4bits_wr(struct gpio_info* gpios, uint8_t bits)
{
	/* High bits */
	lcd_gpio_write(gpios, GPIO_IDX_D4, LOW);
	lcd_gpio_write(gpios, GPIO_IDX_D5, LOW);
	lcd_gpio_write(gpios, GPIO_IDX_D6, LOW);
	lcd_gpio_write(gpios, GPIO_IDX_D7, LOW);
	
	if ((bits & BIT(4)) == BIT(4)) {
		lcd_gpio_write(gpios, GPIO_IDX_D4, HIGH);
	}
	if ((bits & BIT(5)) == BIT(5)) {
		lcd_gpio_write(gpios, GPIO_IDX_D5, HIGH);
	}
	if ((bits & BIT(6)) == BIT(6)) {
		lcd_gpio_write(gpios, GPIO_IDX_D6, HIGH);
	}
	if ((bits & BIT(7)) == BIT(7)) {
		lcd_gpio_write(gpios, GPIO_IDX_D7, HIGH);
	}

	/* Toggle 'Enable' pin */
	_pi_lcd_toggle_enable(gpios);

	/* Low bits */
	lcd_gpio_write(gpios, GPIO_IDX_D4, LOW);
	lcd_gpio_write(gpios, GPIO_IDX_D5, LOW);
	lcd_gpio_write(gpios, GPIO_IDX_D6, LOW);
	lcd_gpio_write(gpios, GPIO_IDX_D7, LOW);

	if ((bits & BIT(0)) == BIT(0)) {
		lcd_gpio_write(gpios, GPIO_IDX_D4, HIGH);
	}
	if ((bits & BIT(1)) == BIT(1)) {
		lcd_gpio_write(gpios, GPIO_IDX_D5, HIGH);
	}
	if ((bits & BIT(2)) == BIT(2)) {
		lcd_gpio_write(gpios, GPIO_IDX_D6, HIGH);
	}
	if ((bits & BIT(3)) == BIT(3)) {
		lcd_gpio_write(gpios, GPIO_IDX_D7, HIGH);
	}

	/* Toggle 'Enable' pin */
	_pi_lcd_toggle_enable(gpios);
}

void _pi_lcd_8bits_wr(struct gpio_info* gpios, uint8_t bits)
{
#if 0
	/* High bits */
	GPIO_PIN_WR(gpio_dev, GPIO_PIN_PC21_D7, LOW);
	GPIO_PIN_WR(gpio_dev, GPIO_PIN_PC22_D6, LOW);
	GPIO_PIN_WR(gpio_dev, GPIO_PIN_PC23_D5, LOW);
	GPIO_PIN_WR(gpio_dev, GPIO_PIN_PC24_D4, LOW);
	GPIO_PIN_WR(gpio_dev, GPIO_PIN_PC15_D3, LOW);
	GPIO_PIN_WR(gpio_dev, GPIO_PIN_PC14_D2, LOW);
	GPIO_PIN_WR(gpio_dev, GPIO_PIN_PC13_D1, LOW);
	GPIO_PIN_WR(gpio_dev, GPIO_PIN_PC12_D0, LOW);

	/* Low bits */
	if ((bits & BIT(0)) == BIT(0)) {
		GPIO_PIN_WR(gpio_dev, GPIO_PIN_PC12_D0, HIGH);
	}
	if ((bits & BIT(1)) == BIT(1)) {
		GPIO_PIN_WR(gpio_dev, GPIO_PIN_PC13_D1, HIGH);
	}
	if ((bits & BIT(2)) == BIT(2)) {
		GPIO_PIN_WR(gpio_dev, GPIO_PIN_PC14_D2, HIGH);
	}
	if ((bits & BIT(3)) == BIT(3)) {
		GPIO_PIN_WR(gpio_dev, GPIO_PIN_PC15_D3, HIGH);
	}
	if ((bits & BIT(4)) == BIT(4)) {
		GPIO_PIN_WR(gpio_dev, GPIO_PIN_PC24_D4, HIGH);
	}
	if ((bits & BIT(5)) == BIT(5)) {
		GPIO_PIN_WR(gpio_dev, GPIO_PIN_PC23_D5, HIGH);
	}
	if ((bits & BIT(6)) == BIT(6)) {
		GPIO_PIN_WR(gpio_dev, GPIO_PIN_PC22_D6, HIGH);
	}
	if ((bits & BIT(7)) == BIT(7)) {
		GPIO_PIN_WR(gpio_dev, GPIO_PIN_PC21_D7, HIGH);
	}

	/* Toggle 'Enable' pin */
	_pi_lcd_toggle_enable(gpio_dev);
#endif
}

void _pi_lcd_data(struct gpio_info* gpios, uint8_t bits)
{
	if (lcd_data.disp_func & LCD_8BIT_MODE) {
#if 0
		_pi_lcd_8bits_wr(gpios, bits);
#else
		printk("8 Bit mode not implemented\n\n");
#endif
	} else {
		_pi_lcd_4bits_wr(gpios, bits);
	}
}

void _pi_lcd_command(struct gpio_info* gpios, uint8_t bits)
{
	/* mode = False for command */
	lcd_gpio_write(gpios, GPIO_IDX_RS, LOW);
	_pi_lcd_data(gpios, bits);
}

void _pi_lcd_write(struct gpio_info* gpios, uint8_t bits)
{
	/* mode = True for character */
	lcd_gpio_write(gpios, GPIO_IDX_RS, HIGH);
	_pi_lcd_data(gpios, bits);
}


/*************************
 * USER can use these APIs
 *************************/
/** Home */
void pi_lcd_home(struct gpio_info* gpios)
{
	_pi_lcd_command(gpios, LCD_RETURN_HOME);
	k_sleep(K_MSEC(2));			/* wait for 2ms */
}

/** Set curson position */
void pi_lcd_set_cursor(struct gpio_info* gpios, uint8_t col, uint8_t row)
{
	size_t max_lines;

	max_lines = ARRAY_SIZE(lcd_data.row_offsets);
	if (row >= max_lines) {
		row = max_lines - 1;	/* Count rows starting w/0 */
	}
	if (row >= lcd_data.cfg_rows) {
		row = lcd_data.cfg_rows - 1;    /* Count rows starting w/0 */
	}
	_pi_lcd_command(gpios, (LCD_SET_DDRAM_ADDR | (col + lcd_data.row_offsets[row])));
}


/** Clear display */
void pi_lcd_clear(struct gpio_info* gpios)
{
	_pi_lcd_command(gpios, LCD_CLEAR_DISPLAY);
	k_sleep(K_MSEC(2));			/* wait for 2ms */
}


/** Display ON */
void pi_lcd_display_on(struct gpio_info* gpios)
{
	lcd_data.disp_cntl |= LCD_DISPLAY_ON;
	_pi_lcd_command(gpios,
			LCD_DISPLAY_CONTROL | lcd_data.disp_cntl);
}

/** Display OFF */
void pi_lcd_display_off(struct gpio_info* gpios)
{
	lcd_data.disp_cntl &= ~LCD_DISPLAY_ON;
	_pi_lcd_command(gpios,
			LCD_DISPLAY_CONTROL | lcd_data.disp_cntl);
}


/** Turns cursor off */
void pi_lcd_cursor_off(struct gpio_info* gpios)
{
	lcd_data.disp_cntl &= ~LCD_CURSOR_ON;
	_pi_lcd_command(gpios,
			LCD_DISPLAY_CONTROL | lcd_data.disp_cntl);
}

/** Turn cursor on */
void pi_lcd_cursor_on(struct gpio_info* gpios)
{
	lcd_data.disp_cntl |= LCD_CURSOR_ON;
	_pi_lcd_command(gpios,
			LCD_DISPLAY_CONTROL | lcd_data.disp_cntl);
}


/** Turn off the blinking cursor */
void pi_lcd_blink_off(struct gpio_info* gpios)
{
	lcd_data.disp_cntl &= ~LCD_BLINK_ON;
	_pi_lcd_command(gpios,
			LCD_DISPLAY_CONTROL | lcd_data.disp_cntl);
}

/** Turn on the blinking cursor */
void pi_lcd_blink_on(struct gpio_info* gpios)
{
	lcd_data.disp_cntl |= LCD_BLINK_ON;
	_pi_lcd_command(gpios,
			LCD_DISPLAY_CONTROL | lcd_data.disp_cntl);
}

/** Scroll the display left without changing the RAM */
void pi_lcd_scroll_left(struct gpio_info* gpios)
{
	_pi_lcd_command(gpios, LCD_CURSOR_SHIFT |
			LCD_DISPLAY_MOVE | LCD_MOVE_LEFT);
}

/** Scroll the display right without changing the RAM */
void pi_lcd_scroll_right(struct gpio_info* gpios)
{
	_pi_lcd_command(gpios, LCD_CURSOR_SHIFT |
			LCD_DISPLAY_MOVE | LCD_MOVE_RIGHT);
}

/** Text that flows from left to right */
void pi_lcd_left_to_right(struct gpio_info* gpios)
{
	lcd_data.disp_mode |= LCD_ENTRY_LEFT;
	_pi_lcd_command(gpios,
			LCD_ENTRY_MODE_SET | lcd_data.disp_cntl);
}

/** Text that flows from right to left */
void pi_lcd_right_to_left(struct gpio_info* gpios)
{
	lcd_data.disp_mode &= ~LCD_ENTRY_LEFT;
	_pi_lcd_command(gpios,
			LCD_ENTRY_MODE_SET | lcd_data.disp_cntl);
}

/** Right justify text from the cursor location */
void pi_lcd_auto_scroll_right(struct gpio_info* gpios)
{
	lcd_data.disp_mode |= LCD_ENTRY_SHIFT_INCREMENT;
	_pi_lcd_command(gpios,
			LCD_ENTRY_MODE_SET | lcd_data.disp_cntl);
}

/** Left justify text from the cursor location */
void pi_lcd_auto_scroll_left(struct gpio_info* gpios)
{
	lcd_data.disp_mode &= ~LCD_ENTRY_SHIFT_INCREMENT;
	_pi_lcd_command(gpios,
			LCD_ENTRY_MODE_SET | lcd_data.disp_cntl);
}

void pi_lcd_string(struct gpio_info* gpios, const char *msg)
{
	int i;
	int len = 0;
	uint8_t data;

	len = strlen(msg);
	if (len > LCD_WIDTH) {
		printk("Too long message! len %d %s\n", len, msg);
	}

	for (i = 0; i < len; i++) {
		data = msg[i];
		_pi_lcd_write(gpios, data);
	}
}


/** LCD initialization function */
void pi_lcd_init(struct gpio_info *gpios, uint8_t cols, uint8_t rows, uint8_t dotsize)
{
	if (rows > 1) {
		lcd_data.disp_func |= LCD_2_LINE;
	}
	lcd_data.cfg_rows = rows;

	_set_row_offsets(0x00, 0x40, 0x00 + cols, 0x40 + cols);

	/* For 1 line displays, a 10 pixel high font looks OK */
	if ((dotsize != LCD_5x8_DOTS) && (rows == 1U)) {
		lcd_data.disp_func |= LCD_5x10_DOTS;
	}

	/* SEE PAGE 45/46 FOR INITIALIZATION SPECIFICATION!
	 * according to datasheet, we need at least 40ms after power rises
	 * above 2.7V before sending commands. Arduino can turn on way
	 * before 4.5V so we'll wait 50
	 */
	k_sleep(K_MSEC(50 * 2));

	/* this is according to the hitachi HD44780 datasheet
	 * figure 23/24, pg 45/46 try to set 4/8 bits mode
	 */
	if (lcd_data.disp_func & LCD_8BIT_MODE) {
#if 0
		/* 1st try */
		_pi_lcd_command(gpios, 0x30);
		k_sleep(K_MSEC(5));			/* wait for 5ms */

		/* 2nd try */
		_pi_lcd_command(gpios, 0x30);
		k_sleep(K_MSEC(5));			/* wait for 5ms */

		/* 3rd try */
		_pi_lcd_command(gpios, 0x30);
		k_sleep(K_MSEC(1));			/* wait for 1ms */

		/* Set 4bit interface */
		_pi_lcd_command(gpios, 0x30);
#else
		printk("8Bit mode not impl\n\n");
#endif
	} else {
		/* 1st try */
		_pi_lcd_command(gpios, 0x03);
		k_sleep(K_MSEC(5 * 2));			/* wait for 5ms */

		/* 2nd try */
		_pi_lcd_command(gpios, 0x03);
		k_sleep(K_MSEC(5 * 2));			/* wait for 5ms */

		/* 3rd try */
		_pi_lcd_command(gpios, 0x03);
		k_sleep(K_MSEC(1 * 3));			/* wait for 1ms */

		/* Set 4bit interface */
		_pi_lcd_command(gpios, 0x02);
	}

	/* finally, set # lines, font size, etc. */
	_pi_lcd_command(gpios, (LCD_FUNCTION_SET | lcd_data.disp_func));

	/* turn the display on with no cursor or blinking default */
	lcd_data.disp_cntl = LCD_DISPLAY_ON | LCD_CURSOR_OFF | LCD_BLINK_OFF;
	pi_lcd_display_on(gpios);

	/* clear it off */
	pi_lcd_clear(gpios);

	/* Initialize to default text direction */
	lcd_data.disp_mode = LCD_ENTRY_LEFT | LCD_ENTRY_SHIFT_DECREMENT;
	/* set the entry mode */
	_pi_lcd_command(gpios, LCD_ENTRY_MODE_SET | lcd_data.disp_mode);
}

static bool gpio_init(struct gpio_info* gpios, int length)
{
	for (int i = 0; i < length; i++) {
		gpios[i].dev = device_get_binding(gpios[i].port);
		if (!gpios[i].dev) {
			printk("Cannot find %s!\n", gpios[i].port);
			return false;
		}
		if (gpio_pin_configure(gpios[i].dev, gpios[i].index, GPIO_OUTPUT)) {
			printk("Failed to set %s_%d as output\n", gpios[i].port, gpios[i].index);
			return false;
		}
	}
	return true;
}

void *lcd_init(void)
{
	struct gpio_info* gpios = global_gpios;
	int ret;

	ret = gpio_init(gpios, ARRAY_SIZE(global_gpios));
	
	if (!ret) {
		printk("Failed to init lcd gpios\n");
		return NULL;
	}

	printk("LCD Init\n");
	pi_lcd_init(gpios, 16, 2, LCD_5x8_DOTS);

	return gpios;
}

void lcd_backlight(void* lcd, bool enable)
{
	struct gpio_info* gpios = lcd;

	lcd_gpio_write(gpios, GPIO_IDX_BL, enable ? HIGH : LOW);
}

void lcd_clear(void* lcd)
{
	struct gpio_info* gpios = lcd;
	pi_lcd_clear(gpios);
}

void lcd_set_cursor(void* lcd, uint8_t col, uint8_t row)
{
	struct gpio_info* gpios = lcd;
	pi_lcd_set_cursor(gpios, col, row);
}

void lcd_string(void* lcd, const char *msg)
{
	struct gpio_info* gpios = lcd;
	pi_lcd_string(gpios, msg);
}

void lcd_scroll_right(void *lcd)
{
	struct gpio_info* gpios = lcd;
	pi_lcd_scroll_right(gpios);
}


void lcd_scroll_left(void *lcd)
{
	struct gpio_info* gpios = lcd;
	pi_lcd_scroll_right(gpios);
}

void lcd_cursor_off(void *lcd)
{
	struct gpio_info* gpios = lcd;
	pi_lcd_cursor_off(gpios);
}

void lcd_cursor_on(void *lcd)
{
	struct gpio_info* gpios = lcd;
	pi_lcd_cursor_on(gpios);
}

void lcd_blink_off(void *lcd)
{
	struct gpio_info* gpios = lcd;
	pi_lcd_blink_off(gpios);
}

void lcd_blink_on(void *lcd)
{
	struct gpio_info* gpios = lcd;
	pi_lcd_blink_on(gpios);
}
```

## src/lcd.h
```c
/*
 * Copyright (c) 2020 Christian Taedcke
 *
 * SPDX-License-Identifier: Apache-2.0
 */

#ifndef APP_LCD_H
#define APP_LCD_H

#include <zephyr.h>

void* lcd_init(void);

void lcd_backlight(void* lcd, bool enable);

void lcd_clear(void* lcd);

/** Set curson position */
void lcd_set_cursor(void* lcd, uint8_t col, uint8_t row);

void lcd_string(void* lcd, const char *msg);

void lcd_scroll_right(void *lcd);

void lcd_scroll_left(void *lcd);

void lcd_cursor_on(void *lcd);

void lcd_cursor_off(void *lcd);

void lcd_blink_on(void *lcd);

void lcd_blink_off(void *lcd);


#endif /* APP_LCD_H */
```

## src/output.c
```c
/*
 * Copyright (c) 2020 Christian Taedcke
 *
 * SPDX-License-Identifier: Apache-2.0
 */

#include "output.h"

#include <sys/printk.h>
#include <drivers/gpio.h>

#if defined(CONFIG_BOARD_NUCLEO_F446RE)
#define GPIO_PIN_OFF		0	/* PC0 */
#define GPIO_PORT_OFF	        "GPIOC"
#define GPIO_PIN_NIGHT		3	/* PC3 */
#define GPIO_PORT_NIGHT	        "GPIOC"
#else
#error "unsupported board"
#endif

#define HIGH				1
#define LOW				0

struct gpio_info {
	const char* port;
	const uint8_t index;
	struct device *dev;
};

/* day is no outut active */
enum gpio_index {
	OUTPUT_IDX_OFF = 0,
	OUTPUT_IDX_NIGHT
};

static struct gpio_info global_gpios[] = {
	{GPIO_PORT_OFF, GPIO_PIN_OFF, NULL},
	{GPIO_PORT_NIGHT, GPIO_PIN_NIGHT, NULL}
};

static bool gpio_init(struct gpio_info* gpios, int length)
{
	for (int i = 0; i < length; i++) {
		gpios[i].dev = device_get_binding(gpios[i].port);
		if (!gpios[i].dev) {
			printk("Cannot find %s!\n", gpios[i].port);
			return false;
		}
		if (gpio_pin_configure(gpios[i].dev, gpios[i].index, GPIO_OUTPUT)) {
			printk("Failed to set %s_%d as output\n", gpios[i].port, gpios[i].index);
			return false;
		}
	}
	return true;
}

static inline void output_gpio_write(struct gpio_info* gpios, enum gpio_index idx, int value)
{
	struct gpio_info *gi = &gpios[idx];
	if (gpio_pin_set_raw(gi->dev, gi->index, value)) {
		printk("Failed to set idx %d to %d\n", idx, value);
	}
}

void output_set(void *dev, enum output_type type)
{
	struct gpio_info* gpios = dev;
	printk("Set output pins for %d\n", type);
	
	switch (type) {
	case OUTPUT_DAY:
		output_gpio_write(gpios, OUTPUT_IDX_OFF, LOW);
		output_gpio_write(gpios, OUTPUT_IDX_NIGHT, LOW);
		break;
	case OUTPUT_NIGHT:
		output_gpio_write(gpios, OUTPUT_IDX_OFF, LOW);
		output_gpio_write(gpios, OUTPUT_IDX_NIGHT, HIGH);
		break;
	case OUTPUT_OFF:
	default:
		output_gpio_write(gpios, OUTPUT_IDX_NIGHT, LOW);
		output_gpio_write(gpios, OUTPUT_IDX_OFF, HIGH);
		break;		
	}
}

void *output_init(void)
{
	struct gpio_info* gpios = global_gpios;
	int ret;

	ret = gpio_init(gpios, ARRAY_SIZE(global_gpios));
	
	if (!ret) {
		printk("Failed to init output gpios\n");
		return NULL;
	}

	return gpios;
}
```

## src/output.h
```c
/*
 * Copyright (c) 2020 Christian Taedcke
 *
 * SPDX-License-Identifier: Apache-2.0
 */

#ifndef APP_OUTPUT_H
#define APP_OUTPUT_H

#include <zephyr.h>

enum output_type {
	OUTPUT_DAY,
	OUTPUT_NIGHT,
	OUTPUT_OFF,
};

void *output_init(void);

void output_set(void *dev, enum output_type type);

#endif /*APP_OUTPUT_H*/
```
